## conf/machine/genericarmv8.conf
```bitbake
#@TYPE: Machine
#@NAME: generic armv8 machine
#@DESCRIPTION: generic machine to be used by linaro-media-create

require conf/machine/include/arm/arch-armv8.inc

MACHINE_FEATURES = ""

# Don't include kernels in standard images
RDEPENDS_kernel-base = ""

PREFERRED_PROVIDER_virtual/kernel = "linux-litmusrt"

KERNEL_IMAGETYPE = "Image"
IMAGE_FSTYPES = "cpio.gz"

SERIAL_CONSOLE = "115200 hvc0"
```
